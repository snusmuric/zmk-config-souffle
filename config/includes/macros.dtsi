#include "layers_definitions.dtsi"

/ {
macros {
        layer_switch_macro: layer_switch_macro {
            compatible = "zmk,behavior-macro-one-param";
            #binding-cells = <1>;
            wait-ms = <30>;  // Add a small delay to ensure proper layer switching
            tap-ms = <30>;   // Add a small delay between taps
            bindings
                = <&macro_release_all>           // Release all held keys (including layer hold)
                , <&macro_wait_time 50>          // Wait for releases to process
                , <&macro_param_1to1>           // Load parameter
                , <&tog MACRO_PLACEHOLDER>      // Toggle target layer
                ;
        };
    };
};
